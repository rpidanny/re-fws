#include <Arduino.h>
#include "SF501.h"

#define pin 13

bool a_on[134] = {
  1, 0, 0, 0, 0, 1, 0, 0, 1, 1, 1, 0, 0, 1,
  0, 0, 1, 1, 1, 0, 0, 1, 0, 0, 1, 1, 0, 0,
  1, 1, 0, 0, 1, 1, 0, 0, 1, 1, 0, 0, 1, 1,
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  1, 0, 0, 1, 0, 0, 1, 1
};

bool a_off[134] = {
  1, 0, 0, 0, 0, 1, 0, 0, 1, 1, 1, 0, 0, 1,
  0, 0, 1, 1, 1, 0, 0, 1, 0, 0, 1, 1, 0, 0,
  1, 1, 0, 0, 1, 1, 0, 0, 1, 1, 0, 0, 1, 1,
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  1, 0, 0, 1, 0, 0, 1, 1
};

SF501 s1(pin);

void setup() {
  // put your setup code here, to run once:
  Serial.begin(9600);
}

void loop() {
  // put your main code here, to run repeatedly:
  if (Serial.available() > 0) {
    int data = Serial.read();
    // Turn on when "1" is received
    if (data == 49 ) {
      s1.press(a_on, 134);
    } else if (data == 48) {
    // Turn off when "0" is received
      s1.press(a_off, 134);
    }
    Serial.print(data);
  }
}
